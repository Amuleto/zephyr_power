## boards/custom/gd32f303rc/board.yml
```yaml
board:
  name: gd32f303rc
  full_name: Custom GD32F303RCT6
  vendor: others
  socs:
    - name: gd32f303
```

## tests/serial_rx/testcase.yaml
```yaml
tests:
  application.serial_rx:
    tags:
      - uart
      - ring_buffer
    platform_allow:
      - qemu_cortex_m3
    integration_platforms:
      - qemu_cortex_m3
```

## west.yml
```yaml
# Reproducible GD32F303 bring-up dependencies. Add modules when enabling new features.
manifest:
  version: "0.13"
  projects:
    - name: zephyr
      url: https://github.com/amuleto/gd32_zephyr.git
      revision: c640e0cd3a50f3627820d619cabc1c50ac806895
      path: gd32_zephyr
      west-commands: scripts/west-commands.yml
    - name: cmsis
      url: https://github.com/zephyrproject-rtos/cmsis
      revision: 512cc7e895e8491696b61f7ba8066b4a182569b8
      path: modules/hal/cmsis
    - name: cmsis_6
      url: https://github.com/zephyrproject-rtos/CMSIS_6
      revision: b2dfbe1a20bbd49c2d2c605073799671074bbb30
      path: modules/hal/cmsis_6
    - name: hal_gigadevice
      url: https://github.com/GD32-MCU-IOT/hal_gigadevice_zephyr.git
      revision: 697bcf7e658b6ed7f9c678fbd975d061f34e7b0a
      path: modules/hal/gigadevice
  self:
    path: firmware
```
