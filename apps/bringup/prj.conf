## CMakeLists.txt
```
cmake_minimum_required(VERSION 3.28.0)

find_package(Zephyr REQUIRED HINTS $ENV{ZEPHYR_BASE})
project(gd32f303rc_bringup)

target_sources(app PRIVATE
  src/main.c
  src/led.c
  src/datetime.c
  src/params.c
  src/board_io.c
  src/serial_rx.c
)
```

## Kconfig
```
mainmenu "Board bring-up"

rsource "Kconfig.serial_rx"

source "Kconfig.zephyr"
```

## Kconfig.serial_rx
```
config APP_UART_RX_BUFFER_SIZE
	int "Receive ring buffer size per business UART"
	default 512
	range 64 4096
	help
	  Size in bytes for each independent USART0 and USART2 receive ring.
	  When full, new bytes are discarded and counted until space is available.
```

## prj.conf
```kconfig
# GPIO
CONFIG_GPIO=y

# Console and shell
CONFIG_PRINTK=y
CONFIG_CONSOLE=y
CONFIG_UART_CONSOLE=y
CONFIG_SHELL=y
CONFIG_SHELL_BACKEND_SERIAL=y
CONFIG_SHELL_LOG_BACKEND=y
CONFIG_SHELL_STACK_SIZE=2048

# Logging through the shell backend
CONFIG_LOG=y
CONFIG_LOG_DEFAULT_LEVEL=3
CONFIG_LOG_BACKEND_UART=n

# Main-task monitoring with hardware watchdog fallback
CONFIG_WATCHDOG=y
CONFIG_TASK_WDT=y
CONFIG_TASK_WDT_CHANNELS=4
CONFIG_TASK_WDT_HW_FALLBACK=y
CONFIG_TASK_WDT_MIN_TIMEOUT=1000
CONFIG_TASK_WDT_HW_FALLBACK_DELAY=2000

# Hardware RTC
CONFIG_RTC=y

# Build artifacts
CONFIG_BUILD_OUTPUT_BIN=y

# MCUboot integration; build both images with --sysbuild.
CONFIG_BOOTLOADER_MCUBOOT=y

# Persistent device parameters
CONFIG_FLASH=y
CONFIG_FLASH_MAP=y
CONFIG_FLASH_PAGE_LAYOUT=y
CONFIG_NVS=y
CONFIG_NVS_DATA_CRC=y
CONFIG_SETTINGS=y
CONFIG_SETTINGS_NVS=y
CONFIG_SETTINGS_NVS_SECTOR_COUNT=4

# Image management and MCUboot status shell
CONFIG_STREAM_FLASH=y
CONFIG_IMG_MANAGER=y
CONFIG_MCUBOOT_SHELL=y

# Precharge board analog inputs
CONFIG_ADC=y

# Independent business UART RX buffers
CONFIG_UART_INTERRUPT_DRIVEN=y
CONFIG_RING_BUFFER=y
CONFIG_APP_UART_RX_BUFFER_SIZE=512
```

## src/main.c
```c
#include <errno.h>

#include <zephyr/device.h>
#include <zephyr/dfu/mcuboot.h>
#include <zephyr/drivers/rtc.h>
#include <zephyr/drivers/watchdog.h>
#include <zephyr/kernel.h>
#include <zephyr/logging/log.h>
#include <zephyr/shell/shell.h>
#include <zephyr/task_wdt/task_wdt.h>

#include "board_io.h"
#include "led.h"
#include "params.h"
#include "serial_rx.h"

#define MAIN_WATCHDOG_TIMEOUT_MS 3000
#define MAIN_LOOP_INTERVAL_MS 500

LOG_MODULE_REGISTER(bringup, LOG_LEVEL_INF);

static int cmd_uptime(const struct shell *sh, size_t argc, char **argv)
{
	ARG_UNUSED(argc);
	ARG_UNUSED(argv);

	shell_print(sh, "Uptime: %lld ms", (long long)k_uptime_get());
	return 0;
}

SHELL_CMD_ARG_REGISTER(uptime, NULL, "Show time since boot", cmd_uptime, 1, 0);

int main(void)
{
	const struct device *wdt = DEVICE_DT_GET(DT_NODELABEL(fwdgt));
	int health_channel;
	int err;

	err = app_board_io_init();
	if (err) {
		LOG_ERR("Board I/O initialization failed: %d", err);
		return 0;
	}

	err = app_serial_rx_init();
	if (err) {
		LOG_ERR("Business UART RX initialization failed: %d", err);
		return 0;
	}

	err = app_params_init();
	if (err) {
		LOG_ERR("Parameter initialization failed: %d", err);
		return 0;
	}

	err = app_led_init();
	if (err) {
		LOG_ERR("LED initialization failed: %d", err);
		return 0;
	}

	LOG_INF("Board %s ready; use help, led on/off/blink, uptime", CONFIG_BOARD);
	if (!device_is_ready(DEVICE_DT_GET(DT_ALIAS(rtc0)))) {
		LOG_ERR("RTC HXTAL/128 initialization failed: %d", -ENODEV);
	} else {
		LOG_INF("Hardware RTC: 8 MHz HXTAL/128, prescaler 62499; "
			"set date to enable UTC time");
	}

	if (!device_is_ready(wdt)) {
		LOG_ERR("Hardware watchdog not ready");
		return 0;
	}

	err = task_wdt_init(wdt);
	if (err) {
		LOG_ERR("Watchdog initialization failed: %d", err);
		return 0;
	}

	health_channel = task_wdt_add(MAIN_WATCHDOG_TIMEOUT_MS, NULL, NULL);
	if (health_channel < 0) {
		LOG_ERR("Watchdog registration failed: %d", health_channel);
		return 0;
	}

	LOG_INF("Main task monitored: %d ms; hardware fallback enabled",
		MAIN_WATCHDOG_TIMEOUT_MS);

	/* Confirm only after the current startup checks have succeeded. */
	err = boot_write_img_confirmed();
	if (err) {
		LOG_ERR("Image confirmation failed: %d", err);
		return 0;
	}

	for (;;) {
		err = app_led_update();
		if (err) {
			LOG_ERR("LED toggle failed: %d", err);
			return 0;
		}

		/* Report health only after the monitored work has completed. */
		task_wdt_feed(health_channel);
		k_msleep(MAIN_LOOP_INTERVAL_MS);
	}
}
```

## src/board_io.c
```c
#include <errno.h>

#include <zephyr/drivers/adc.h>
#include <zephyr/drivers/gpio.h>
#include <zephyr/kernel.h>
#include <zephyr/shell/shell.h>

#include "board_io.h"

#define USER_NODE DT_PATH(zephyr_user)
#define ADC_SPEC(node_id, prop, idx) ADC_DT_SPEC_GET_BY_IDX(node_id, idx),
#define RELAY_SPEC(node_id, prop, idx) GPIO_DT_SPEC_GET_BY_IDX(node_id, prop, idx),

static const struct adc_dt_spec inputs[] = {
	DT_FOREACH_PROP_ELEM(USER_NODE, io_channels, ADC_SPEC)
};
static const char *const input_names[] = DT_PROP(USER_NODE, io_channel_names);
static const struct gpio_dt_spec relays[] = {
	DT_FOREACH_PROP_ELEM(USER_NODE, relay_gpios, RELAY_SPEC)
};
static const struct gpio_dt_spec rs485_de = GPIO_DT_SPEC_GET(USER_NODE, rs485_de_gpios);

static K_MUTEX_DEFINE(board_lock);
static bool board_ready;

BUILD_ASSERT(ARRAY_SIZE(inputs) == ARRAY_SIZE(input_names));
BUILD_ASSERT(ARRAY_SIZE(relays) == 4);

int app_board_io_init(void)
{
	int err;

	/* Establish inactive outputs before allowing any other board operation. */
	for (size_t i = 0; i < ARRAY_SIZE(relays); i++) {
		if (!gpio_is_ready_dt(&relays[i])) {
			return -ENODEV;
		}
		err = gpio_pin_configure_dt(&relays[i], GPIO_OUTPUT_INACTIVE);
		if (err) {
			return err;
		}
	}

	if (!gpio_is_ready_dt(&rs485_de)) {
		return -ENODEV;
	}
	err = gpio_pin_configure_dt(&rs485_de, GPIO_OUTPUT_INACTIVE);
	if (err) {
		return err;
	}

	for (size_t i = 0; i < ARRAY_SIZE(inputs); i++) {
		if (!adc_is_ready_dt(&inputs[i])) {
			return -ENODEV;
		}
		err = adc_channel_setup_dt(&inputs[i]);
		if (err) {
			return err;
		}
	}

	if (!device_is_ready(DEVICE_DT_GET(DT_ALIAS(factory_uart))) ||
	    !device_is_ready(DEVICE_DT_GET(DT_ALIAS(rs485_uart)))) {
		return -ENODEV;
	}

	k_mutex_lock(&board_lock, K_FOREVER);
	board_ready = true;
	k_mutex_unlock(&board_lock);
	return 0;
}

int app_board_relay_set(size_t index, bool enabled)
{
	int err;

	if (index >= ARRAY_SIZE(relays)) {
		return -EINVAL;
	}

	k_mutex_lock(&board_lock, K_FOREVER);
	err = board_ready ? gpio_pin_set_dt(&relays[index], enabled) : -EAGAIN;
	k_mutex_unlock(&board_lock);
	return err;
}

int app_board_rs485_direction_set(bool transmit)
{
	int err;

	k_mutex_lock(&board_lock, K_FOREVER);
	err = board_ready ? gpio_pin_set_dt(&rs485_de, transmit) : -EAGAIN;
	k_mutex_unlock(&board_lock);
	return err;
}

static int cmd_board_adc(const struct shell *sh, size_t argc, char **argv)
{
	struct adc_sequence sequence;
	int16_t raw;
	int32_t millivolts;
	int err;

	ARG_UNUSED(argc);
	ARG_UNUSED(argv);

	k_mutex_lock(&board_lock, K_FOREVER);
	if (!board_ready) {
		k_mutex_unlock(&board_lock);
		return -EAGAIN;
	}
	k_mutex_unlock(&board_lock);

	for (size_t i = 0; i < ARRAY_SIZE(inputs); i++) {
		sequence = (struct adc_sequence){
			.buffer = &raw,
			.buffer_size = sizeof(raw),
		};
		err = adc_sequence_init_dt(&inputs[i], &sequence);
		if (!err) {
			err = adc_read_dt(&inputs[i], &sequence);
		}
		if (err) {
			shell_error(sh, "%s: ADC read failed: %d", input_names[i], err);
			return err;
		}

		/* Pin voltage only: the high-voltage front-end needs separate calibration. */
		millivolts = raw;
		err = adc_raw_to_millivolts_dt(&inputs[i], &millivolts);
		if (err) {
			return err;
		}
		shell_print(sh, "%s: raw=%d, pin=%d mV (nominal VDDA)",
			    input_names[i], raw, millivolts);
	}

	return 0;
}

SHELL_STATIC_SUBCMD_SET_CREATE(board_commands,
	SHELL_CMD_ARG(adc, NULL, "Read eight measurement inputs and the 3 V monitor",
		      cmd_board_adc, 1, 0),
	SHELL_SUBCMD_SET_END
);
SHELL_CMD_REGISTER(board, &board_commands, "Board diagnostics", NULL);
```

## src/board_io.h
```c
#ifndef BRINGUP_BOARD_IO_H_
#define BRINGUP_BOARD_IO_H_

#include <stdbool.h>
#include <stddef.h>

/**
 * @brief Initialize board outputs inactive and configure ADC channels.
 *
 * No relay is energized and RS485 direction defaults to receive. Call once
 * during startup, from thread context, before using the board interfaces.
 *
 * @return 0 on success, or a negative GPIO/ADC/device error code.
 */
int app_board_io_init(void);

/**
 * @brief Control one precharge relay.
 *
 * This low-level function does not implement precharge timing or interlocks.
 * Callers must provide the application sequencing before energizing a relay.
 *
 * @param index Zero-based relay index, 0 through 3.
 * @param enabled True to energize, false to de-energize.
 *
 * @return 0 on success, or a negative GPIO error code.
 * @retval -EINVAL Invalid index.
 * @retval -EAGAIN Board initialization has not completed successfully.
 */
int app_board_relay_set(size_t index, bool enabled);

/**
 * @brief Select the RS485 transceiver direction on PB8.
 *
 * The transceiver direction signal must be physically connected to PB8.
 * Before switching to receive, the caller must wait for the final UART stop
 * bit to leave the transmitter; this function does not serialize UART traffic.
 *
 * @param transmit True for transmit, false for receive.
 *
 * @return 0 on success, or a negative GPIO error code.
 * @retval -EAGAIN Board initialization has not completed successfully.
 */
int app_board_rs485_direction_set(bool transmit);

#endif /* BRINGUP_BOARD_IO_H_ */
```

## src/datetime.c
```c
#include <errno.h>
#include <stdio.h>
#include <time.h>

#include <zephyr/drivers/rtc.h>
#include <zephyr/kernel.h>
#include <zephyr/shell/shell.h>

static const struct device *const rtc_dev = DEVICE_DT_GET(DT_ALIAS(rtc0));
static K_MUTEX_DEFINE(clock_lock);

static int parse_datetime(const char *date, const char *time, struct rtc_time *value)
{
	static const int days[] = {31, 28, 31, 30, 31, 30, 31, 31, 30, 31, 30, 31};
	int year;
	int month;
	int day;
	int hour;
	int minute;
	int second;
	int max_day;
	char extra;

	/* The trailing conversion rejects unexpected characters after each field. */
	if (sscanf(date, "%d-%d-%d%c", &year, &month, &day, &extra) != 3 ||
	    sscanf(time, "%d:%d:%d%c", &hour, &minute, &second, &extra) != 3 ||
	    year < 2000 || year > 2099 || month < 1 || month > 12 ||
	    hour < 0 || hour > 23 || minute < 0 || minute > 59 ||
	    second < 0 || second > 59) {
		return -EINVAL;
	}

	/* All years supported by this driver fall within 2000-2099. */
	max_day = days[month - 1] + (month == 2 && year % 4 == 0);
	if (day < 1 || day > max_day) {
		return -ERANGE;
	}

	value->tm_year = year - 1900;
	value->tm_mon = month - 1;
	value->tm_mday = day;
	value->tm_hour = hour;
	value->tm_min = minute;
	value->tm_sec = second;

	return 0;
}

static int set_datetime(const struct shell *sh, const char *date, const char *time)
{
	struct rtc_time value = {0};
	int err;

	err = parse_datetime(date, time, &value);
	if (err == -ERANGE) {
		shell_error(sh, "Invalid calendar date");
		return -EINVAL;
	}
	if (err) {
		shell_error(sh, "Use: date YYYY-MM-DD HH:MM:SS (UTC, 2000-2099)");
		return err;
	}

	k_mutex_lock(&clock_lock, K_FOREVER);
	err = rtc_set_time(rtc_dev, &value);
	k_mutex_unlock(&clock_lock);
	if (err) {
		shell_error(sh, "RTC write failed: %d", err);
	}

	return err;
}

static int cmd_date(const struct shell *sh, size_t argc, char **argv)
{
	struct rtc_time current = {0};
	int err;

	if (!device_is_ready(rtc_dev)) {
		shell_error(sh, "RTC device not ready");
		return -ENODEV;
	}

	if (argc == 3) {
		err = set_datetime(sh, argv[1], argv[2]);
		if (err) {
			return err;
		}
	} else if (argc != 1) {
		shell_error(sh, "Use: date [YYYY-MM-DD HH:MM:SS]");
		return -EINVAL;
	}

	/* HXTAL does not keep time on VBAT alone; require setting after boot. */
	k_mutex_lock(&clock_lock, K_FOREVER);
	err = rtc_get_time(rtc_dev, &current);
	k_mutex_unlock(&clock_lock);
	if (err) {
		shell_error(sh, "RTC read failed: %d (set date after boot)", err);
		return err;
	}

	shell_print(sh, "%04d-%02d-%02d %02d:%02d:%02d UTC",
		    current.tm_year + 1900, current.tm_mon + 1, current.tm_mday,
		    current.tm_hour, current.tm_min, current.tm_sec);
	return 0;
}

SHELL_CMD_ARG_REGISTER(date, NULL, "UTC RTC time: date [YYYY-MM-DD HH:MM:SS]",
		       cmd_date, 1, 2);
```

## src/led.c
```c
#include <errno.h>
#include <string.h>

#include <zephyr/drivers/gpio.h>
#include <zephyr/kernel.h>
#include <zephyr/shell/shell.h>

#include "led.h"

enum led_mode {
	LED_OFF,
	LED_ON,
	LED_BLINK,
};

static const struct gpio_dt_spec led = GPIO_DT_SPEC_GET(DT_ALIAS(led0), gpios);
static K_MUTEX_DEFINE(led_lock);
static enum led_mode mode = LED_BLINK;
static bool led_ready;

int app_led_init(void)
{
	int err;

	k_mutex_lock(&led_lock, K_FOREVER);
	err = gpio_is_ready_dt(&led) ?
		gpio_pin_configure_dt(&led, GPIO_OUTPUT_INACTIVE) : -ENODEV;
	led_ready = (err == 0);
	k_mutex_unlock(&led_lock);

	return err;
}

int app_led_update(void)
{
	int err;

	k_mutex_lock(&led_lock, K_FOREVER);
	err = mode == LED_BLINK ? gpio_pin_toggle_dt(&led) : 0;
	k_mutex_unlock(&led_lock);

	return err;
}

static int cmd_led(const struct shell *sh, size_t argc, char **argv)
{
	enum led_mode next;
	int err;

	ARG_UNUSED(argc);

	if (!strcmp(argv[1], "on")) {
		next = LED_ON;
	} else if (!strcmp(argv[1], "off")) {
		next = LED_OFF;
	} else if (!strcmp(argv[1], "blink")) {
		next = LED_BLINK;
	} else {
		shell_error(sh, "Usage: led <on|off|blink>");
		return -EINVAL;
	}

	/* Shell commands and the main loop share the GPIO and mode state. */
	k_mutex_lock(&led_lock, K_FOREVER);
	err = led_ready ? gpio_pin_set_dt(&led, next != LED_OFF) : -ENODEV;
	if (!err) {
		mode = next;
	}
	k_mutex_unlock(&led_lock);

	if (err) {
		shell_error(sh, "LED unavailable: %d", err);
		return err;
	}

	shell_print(sh, "LED mode: %s", argv[1]);
	return 0;
}

SHELL_CMD_ARG_REGISTER(led, NULL, "LED control: on, off, blink", cmd_led, 2, 0);
```

## src/led.h
```c
#ifndef BRINGUP_LED_H_
#define BRINGUP_LED_H_

/* Initialize the board LED. Return zero on success or a negative errno. */
int app_led_init(void);

/* Advance blinking once; steady modes remain unchanged. */
int app_led_update(void);

#endif /* BRINGUP_LED_H_ */
```

## src/params.c
```c
#include <errno.h>
#include <stdint.h>
#include <stdlib.h>
#include <string.h>

#include <zephyr/kernel.h>
#include <zephyr/settings/settings.h>
#include <zephyr/shell/shell.h>
#include <zephyr/sys/byteorder.h>

#include "params.h"

#define PARAMS_DEFAULT_DEVICE_ID 1U
#define PARAMS_DEVICE_ID_KEY "app/device_id"

static K_MUTEX_DEFINE(params_lock);
static uint32_t current_device_id = PARAMS_DEFAULT_DEVICE_ID;
static bool params_ready;
static int load_error;

static int params_load(const char *name, size_t len, settings_read_cb read_cb, void *cb_arg)
{
	uint8_t encoded[sizeof(uint32_t)];
	ssize_t count;

	if (strcmp(name, "device_id") != 0) {
		return -ENOENT;
	}
	if (len != sizeof(encoded)) {
		load_error = -EINVAL;
		return load_error;
	}

	count = read_cb(cb_arg, encoded, sizeof(encoded));
	if (count < 0) {
		load_error = (int)count;
		return load_error;
	}
	if (count != sizeof(encoded)) {
		load_error = -EIO;
		return load_error;
	}

	/* Stable on-Flash representation, independent of CPU byte order. */
	k_mutex_lock(&params_lock, K_FOREVER);
	current_device_id = sys_get_le32(encoded);
	k_mutex_unlock(&params_lock);
	return 0;
}

static int params_commit(void)
{
	/* Settings load does not propagate h_set errors; report them at commit. */
	return load_error;
}

SETTINGS_STATIC_HANDLER_DEFINE(app_params, "app", NULL, params_load, params_commit, NULL);

int app_params_init(void)
{
	int err;

	err = settings_subsys_init();
	if (err) {
		return err;
	}

	err = settings_load_subtree("app");
	if (err) {
		return err;
	}

	k_mutex_lock(&params_lock, K_FOREVER);
	params_ready = true;
	k_mutex_unlock(&params_lock);
	return 0;
}

int app_params_get_device_id(uint32_t *device_id)
{
	if (device_id == NULL) {
		return -EINVAL;
	}

	k_mutex_lock(&params_lock, K_FOREVER);
	if (!params_ready) {
		k_mutex_unlock(&params_lock);
		return -EAGAIN;
	}

	*device_id = current_device_id;
	k_mutex_unlock(&params_lock);
	return 0;
}

int app_params_set_device_id(uint32_t device_id)
{
	uint8_t encoded[sizeof(uint32_t)];
	int err;

	k_mutex_lock(&params_lock, K_FOREVER);
	if (!params_ready) {
		k_mutex_unlock(&params_lock);
		return -EAGAIN;
	}

	if (device_id == current_device_id) {
		k_mutex_unlock(&params_lock);
		return 0;
	}

	sys_put_le32(device_id, encoded);
	err = settings_save_one(PARAMS_DEVICE_ID_KEY, encoded, sizeof(encoded));
	if (!err) {
		current_device_id = device_id;
	}
	k_mutex_unlock(&params_lock);
	return err;
}

static int cmd_param_get(const struct shell *sh, size_t argc, char **argv)
{
	uint32_t device_id;
	int err;

	ARG_UNUSED(argc);
	ARG_UNUSED(argv);

	err = app_params_get_device_id(&device_id);
	if (err) {
		shell_error(sh, "Parameter read failed: %d", err);
		return err;
	}

	shell_print(sh, "device_id=%lu", (unsigned long)device_id);
	return 0;
}

static int cmd_param_set(const struct shell *sh, size_t argc, char **argv)
{
	unsigned long parsed;
	char *end;
	int err;

	ARG_UNUSED(argc);

	/* Accept decimal digits only; strtoul alone would accept a minus sign. */
	if (argv[1][0] == '\0' || strspn(argv[1], "0123456789") != strlen(argv[1])) {
		return -EINVAL;
	}

	errno = 0;
	parsed = strtoul(argv[1], &end, 10);
	if (errno == ERANGE || *end != '\0' || parsed > UINT32_MAX) {
		return -ERANGE;
	}

	err = app_params_set_device_id((uint32_t)parsed);
	if (err) {
		shell_error(sh, "Parameter save failed: %d", err);
		return err;
	}

	shell_print(sh, "Saved device_id=%lu", parsed);
	return 0;
}

SHELL_STATIC_SUBCMD_SET_CREATE(param_commands,
	SHELL_CMD_ARG(get, NULL, "Read device identifier", cmd_param_get, 1, 0),
	SHELL_CMD_ARG(set, NULL, "Save decimal device identifier: param set <id>",
		      cmd_param_set, 2, 0),
	SHELL_SUBCMD_SET_END
);
SHELL_CMD_REGISTER(param, &param_commands, "Persistent device parameters", NULL);
```

## src/params.h
```c
#ifndef BRINGUP_PARAMS_H_
#define BRINGUP_PARAMS_H_

#include <stdint.h>

/**
 * @brief Initialize Settings/NVS and load device parameters.
 *
 * Call once during startup before using the other parameter functions.
 * Missing values retain defaults. Initialization never erases the partition
 * as an error-recovery action.
 *
 * @return 0 on success, or a negative error code on storage failure.
 */
int app_params_init(void);

/**
 * @brief Read the device identifier currently held in RAM.
 *
 * @param[out] device_id Destination for the identifier. Must not be NULL.
 *
 * @retval 0 Identifier read successfully.
 * @retval -EINVAL NULL destination.
 * @retval -EAGAIN Parameter initialization has not completed successfully.
 */
int app_params_get_device_id(uint32_t *device_id);

/**
 * @brief Persist a device identifier and update its RAM copy on success.
 *
 * This operation writes Flash and must be called from thread context.
 *
 * @param device_id Identifier in the full uint32_t range; default is 1.
 *
 * @return 0 on success, or a negative storage error code.
 * @retval -EAGAIN Parameter initialization has not completed successfully.
 */
int app_params_set_device_id(uint32_t device_id);

#endif /* BRINGUP_PARAMS_H_ */
```

## src/serial_rx.c
```c
#include <errno.h>
#include <string.h>

#include <zephyr/drivers/uart.h>
#include <zephyr/sys/atomic.h>
#include <zephyr/sys/ring_buffer.h>

#if defined(CONFIG_SHELL)
#include <zephyr/shell/shell.h>
#endif

#include "serial_rx.h"

struct serial_rx_context {
	const struct device *dev;
	struct ring_buf ring;
	struct k_spinlock lock;
	struct k_sem available;
	struct app_serial_rx_stats stats;
	uint8_t storage[CONFIG_APP_UART_RX_BUFFER_SIZE];
};

static struct serial_rx_context ports[APP_SERIAL_PORT_COUNT] = {
	[APP_SERIAL_FACTORY] = {.dev = DEVICE_DT_GET(DT_ALIAS(factory_uart))},
	[APP_SERIAL_RS485] = {.dev = DEVICE_DT_GET(DT_ALIAS(rs485_uart))},
};
static K_MUTEX_DEFINE(init_lock);
static atomic_t initialized;

BUILD_ASSERT(!DT_SAME_NODE(DT_ALIAS(factory_uart), DT_ALIAS(rs485_uart)));
#if DT_HAS_CHOSEN(zephyr_shell_uart)
BUILD_ASSERT(!DT_SAME_NODE(DT_ALIAS(factory_uart), DT_CHOSEN(zephyr_shell_uart)));
BUILD_ASSERT(!DT_SAME_NODE(DT_ALIAS(rs485_uart), DT_CHOSEN(zephyr_shell_uart)));
#endif

static bool port_valid(enum app_serial_port port)
{
	return (unsigned int)port < APP_SERIAL_PORT_COUNT;
}

static void receive_irq(const struct device *dev, void *user_data)
{
	struct serial_rx_context *ctx = user_data;
	uint8_t bytes[16];
	k_spinlock_key_t key;
	uint32_t stored;
	int errors;
	int count;

	if (!uart_irq_update(dev)) {
		return;
	}

	/* Check errors even when a callback was caused by an error-only interrupt. */
	errors = uart_err_check(dev);
	if (errors > 0) {
		key = k_spin_lock(&ctx->lock);
		ctx->stats.error_events++;
		ctx->stats.error_mask |= (uint32_t)errors;
		k_spin_unlock(&ctx->lock, key);
	}

	while (uart_irq_rx_ready(dev)) {
		count = uart_fifo_read(dev, bytes, sizeof(bytes));
		if (count <= 0) {
			break;
		}

		/* Always drain hardware, including when the software ring is full. */
		key = k_spin_lock(&ctx->lock);
		stored = ring_buf_put(&ctx->ring, bytes, count);
		ctx->stats.received += (uint32_t)count;
		ctx->stats.dropped += (uint32_t)count - stored;
		k_spin_unlock(&ctx->lock, key);
		if (stored > 0) {
			k_sem_give(&ctx->available);
		}
	}
}

int app_serial_rx_init(void)
{
	int attached = 0;
	int err = 0;

	k_mutex_lock(&init_lock, K_FOREVER);
	if (atomic_get(&initialized)) {
		err = -EALREADY;
		goto out;
	}

	for (size_t i = 0; i < ARRAY_SIZE(ports); i++) {
		if (!device_is_ready(ports[i].dev)) {
			err = -ENODEV;
			goto out;
		}
	}

	for (size_t i = 0; i < ARRAY_SIZE(ports); i++) {
		struct serial_rx_context *ctx = &ports[i];

		uart_irq_rx_disable(ctx->dev);
		uart_irq_err_disable(ctx->dev);
		ring_buf_init(&ctx->ring, sizeof(ctx->storage), ctx->storage);
		k_sem_init(&ctx->available, 0, 1);
		err = uart_irq_callback_user_data_set(ctx->dev, receive_irq, ctx);
		if (err) {
			goto rollback;
		}
		attached++;
	}

	/* Publish initialized state before an enabled interrupt can wake a reader. */
	atomic_set(&initialized, 1);
	for (size_t i = 0; i < ARRAY_SIZE(ports); i++) {
		uart_irq_err_enable(ports[i].dev);
		uart_irq_rx_enable(ports[i].dev);
	}
	goto out;

rollback:
	for (int i = 0; i < attached; i++) {
		(void)uart_irq_callback_user_data_set(ports[i].dev, NULL, NULL);
	}

out:
	k_mutex_unlock(&init_lock);
	return err;
}

ssize_t app_serial_rx_read(enum app_serial_port port, uint8_t *buffer,
			   size_t length, k_timeout_t timeout)
{
	struct serial_rx_context *ctx;
	k_spinlock_key_t key;
	k_timepoint_t deadline;
	uint32_t count;

	if (!port_valid(port) || (buffer == NULL && length != 0) || length > UINT32_MAX) {
		return -EINVAL;
	}
	if (k_is_in_isr()) {
		return -EWOULDBLOCK;
	}
	if (!atomic_get(&initialized)) {
		return -EAGAIN;
	}
	if (length == 0) {
		return 0;
	}

	ctx = &ports[port];
	deadline = sys_timepoint_calc(timeout);
	for (;;) {
		key = k_spin_lock(&ctx->lock);
		count = ring_buf_get(&ctx->ring, buffer, length);
		k_spin_unlock(&ctx->lock, key);
		if (count > 0) {
			return count;
		}

		/* Notifications coalesce; a stale token must not restart the timeout. */
		if (k_sem_take(&ctx->available, sys_timepoint_timeout(deadline)) != 0) {
			return 0;
		}
	}
}

int app_serial_rx_stats_get(enum app_serial_port port, struct app_serial_rx_stats *stats)
{
	struct serial_rx_context *ctx;
	k_spinlock_key_t key;

	if (!port_valid(port) || stats == NULL) {
		return -EINVAL;
	}
	if (!atomic_get(&initialized)) {
		return -EAGAIN;
	}

	ctx = &ports[port];
	key = k_spin_lock(&ctx->lock);
	*stats = ctx->stats;
	stats->pending = ring_buf_size_get(&ctx->ring);
	stats->capacity = sizeof(ctx->storage);
	k_spin_unlock(&ctx->lock, key);
	return 0;
}

#if defined(CONFIG_SHELL)
static const char *const port_names[] = {"factory", "rs485"};

static int cmd_serial_stats(const struct shell *sh, size_t argc, char **argv)
{
	struct app_serial_rx_stats stats;
	int err;

	ARG_UNUSED(argc);
	ARG_UNUSED(argv);

	for (int i = 0; i < APP_SERIAL_PORT_COUNT; i++) {
		err = app_serial_rx_stats_get(i, &stats);
		if (err) {
			return err;
		}
		shell_print(sh, "%s: pending=%u/%u received=%u dropped=%u errors=%u mask=0x%x",
			    port_names[i], stats.pending, stats.capacity, stats.received,
			    stats.dropped, stats.error_events, stats.error_mask);
	}
	return 0;
}

static int cmd_serial_read(const struct shell *sh, size_t argc, char **argv)
{
	uint8_t bytes[64];
	ssize_t count;

	ARG_UNUSED(argc);

	for (int i = 0; i < APP_SERIAL_PORT_COUNT; i++) {
		if (strcmp(argv[1], port_names[i]) != 0) {
			continue;
		}
		count = app_serial_rx_read(i, bytes, sizeof(bytes), K_NO_WAIT);
		if (count < 0) {
			return (int)count;
		}
		if (count == 0) {
			shell_print(sh, "No buffered data");
		} else {
			shell_hexdump(sh, bytes, count);
		}
		return 0;
	}

	shell_error(sh, "Use: serial read <factory|rs485>");
	return -EINVAL;
}

SHELL_STATIC_SUBCMD_SET_CREATE(serial_commands,
	SHELL_CMD_ARG(stats, NULL, "Show RX occupancy, drops and hardware errors",
		      cmd_serial_stats, 1, 0),
	SHELL_CMD_ARG(read, NULL, "Consume up to 64 RX bytes: serial read <factory|rs485>",
		      cmd_serial_read, 2, 0),
	SHELL_SUBCMD_SET_END
);
SHELL_CMD_REGISTER(serial, &serial_commands, "Business UART RX buffers", NULL);
#endif
```

## src/serial_rx.h
```c
#ifndef BRINGUP_SERIAL_RX_H_
#define BRINGUP_SERIAL_RX_H_

#include <stddef.h>
#include <stdint.h>
#include <sys/types.h>

#include <zephyr/kernel.h>

/** Business UART identifiers; UART4 belongs exclusively to the Shell. */
enum app_serial_port {
	APP_SERIAL_FACTORY,
	APP_SERIAL_RS485,
	APP_SERIAL_PORT_COUNT,
};

/** Snapshot of receive state; cumulative counters wrap modulo 2^32. */
struct app_serial_rx_stats {
	uint32_t pending; /**< Bytes currently buffered. */
	uint32_t capacity; /**< Buffer capacity in bytes. */
	uint32_t received; /**< Bytes read from the hardware, including dropped bytes. */
	uint32_t dropped; /**< New bytes discarded because the ring was full. */
	uint32_t error_events; /**< Positive UART error reports; not a lost-byte count. */
	uint32_t error_mask; /**< Accumulated UART_ERROR_* flags. */
};

/**
 * @brief Register receive callbacks and enable both business UARTs.
 *
 * Call once at startup from thread context. No TX interrupts or RS485 direction
 * changes are performed. The callbacks own RX on these two devices thereafter.
 *
 * @return 0 on success, or a negative driver error code.
 * @retval -ENODEV A device is not ready.
 * @retval -EALREADY The module has already been initialized.
 */
int app_serial_rx_init(void);

/**
 * @brief Read available bytes, waiting at most timeout for the first byte.
 *
 * Use one consumer thread per port. Returned chunks are not protocol frames.
 * Overflow drops new bytes and preserves queued bytes; monitor the counters to
 * detect stream discontinuities. Do not use uart_poll_in() on these devices.
 *
 * @param port Business UART to read.
 * @param[out] buffer Destination, valid for at least length bytes; may be NULL
 *                    only when length is zero.
 * @param length Maximum byte count to copy.
 * @param timeout Wait for data; K_NO_WAIT polls and K_FOREVER waits indefinitely.
 *
 * @return Positive byte count, zero on timeout or zero length, or negative errno.
 * @retval -EINVAL Invalid port, destination or length above UINT32_MAX.
 * @retval -EAGAIN The module is not initialized.
 * @retval -EWOULDBLOCK Called from interrupt context.
 */
ssize_t app_serial_rx_read(enum app_serial_port port, uint8_t *buffer,
			   size_t length, k_timeout_t timeout);

/**
 * @brief Obtain a consistent receive statistics snapshot.
 *
 * @param port Business UART to inspect.
 * @param[out] stats Destination for the snapshot; must not be NULL.
 *
 * @retval 0 Snapshot copied.
 * @retval -EINVAL Invalid port or NULL destination.
 * @retval -EAGAIN The module is not initialized.
 */
int app_serial_rx_stats_get(enum app_serial_port port, struct app_serial_rx_stats *stats);

#endif /* BRINGUP_SERIAL_RX_H_ */
```
