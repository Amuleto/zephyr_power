## CMakeLists.txt
```
cmake_minimum_required(VERSION 3.28.0)

find_package(Zephyr REQUIRED HINTS $ENV{ZEPHYR_BASE})
project(gd32f303rc_bringup)

target_sources(app PRIVATE
  app.c
  precharge/precharge.c
  precharge/precharge_io.c
  host_link/host_link.c
  host_link/host_protocol.c
  gpio_shell.c
  precharge/mp10.c
  datetime.c
)

target_sources_ifdef(CONFIG_SETTINGS_NVS app PRIVATE params.c)

add_subdirectory(../../bsp ${CMAKE_CURRENT_BINARY_DIR}/bsp)
target_include_directories(app PRIVATE inc)
```

## Kconfig
```
mainmenu "Board bring-up"

rsource "Kconfig.serial_rx"

source "Kconfig.zephyr"

config APP_LEAKAGE_LIMIT_DECI_MA
    int "Leakage threshold in 0.1 mA (0 disables)"
    default 0
    range 0 2147483647

config APP_LEAKAGE_DURATION_MS
    int "Continuous leakage duration in ms (0 disables)"
    default 0
    range 0 2147483647
```

## Kconfig.serial_rx
```
config APP_UART_RX_BUFFER_SIZE
	int "Receive ring buffer size per business UART"
	default 512
	range 64 4096
	help
	  Size in bytes for each independent USART0 and USART2 receive ring.
	  When full, new bytes are discarded and counted until space is available.
```

## prj.conf
```kconfig
# GPIO
CONFIG_GPIO=y

# Console and shell
CONFIG_PRINTK=y
CONFIG_CONSOLE=y
CONFIG_UART_CONSOLE=y
CONFIG_SHELL=y
CONFIG_SHELL_BACKEND_SERIAL=y
CONFIG_SHELL_STACK_SIZE=2048
CONFIG_SHELL_WILDCARD=n
CONFIG_SHELL_VT100_COLORS=n
CONFIG_SHELL_METAKEYS=n
CONFIG_SHELL_CMDS_RESIZE=n
CONFIG_SHELL_PROMPT_CHANGE=n

# Logging through the shell backend
CONFIG_LOG=y
CONFIG_LOG_OUTPUT_FORMAT_CUSTOM_TIMESTAMP=y
CONFIG_LOG_DEFAULT_LEVEL=2
CONFIG_LOG_BACKEND_UART=n
CONFIG_SHELL_LOG_BACKEND=y
CONFIG_SHELL_LOG_OUTPUT_LEVEL=n
CONFIG_LOG_OUTPUT_HEXDUMP_SINGLE_LINE=y
# Allow a complete 520-byte binary RS485 frame plus log metadata.
CONFIG_SHELL_BACKEND_SERIAL_LOG_MESSAGE_QUEUE_SIZE=1024

# Task monitoring with hardware watchdog fallback
CONFIG_WATCHDOG=y
CONFIG_TASK_WDT=y
CONFIG_TASK_WDT_CHANNELS=4
CONFIG_TASK_WDT_HW_FALLBACK=y
CONFIG_TASK_WDT_MIN_TIMEOUT=1000
CONFIG_TASK_WDT_HW_FALLBACK_DELAY=2000

# Hardware RTC
CONFIG_RTC=y

# Build artifacts
CONFIG_BUILD_OUTPUT_BIN=y

# MCUboot integration; build both images with --sysbuild.
CONFIG_BOOTLOADER_MCUBOOT=y

# Persistent device parameters
CONFIG_FLASH=y
CONFIG_FLASH_MAP=y
CONFIG_FLASH_PAGE_LAYOUT=y
CONFIG_NVS=n
CONFIG_SETTINGS=n

# Image management and MCUboot status shell
CONFIG_STREAM_FLASH=y
CONFIG_IMG_MANAGER=y
CONFIG_MCUBOOT_SHELL=y

# Precharge board analog inputs
CONFIG_ADC=y

# Independent business UART RX buffers
CONFIG_UART_INTERRUPT_DRIVEN=y
CONFIG_RING_BUFFER=y
CONFIG_APP_UART_RX_BUFFER_SIZE=512

# CAN0 diagnostics
CONFIG_CAN=y
CONFIG_CAN_SHELL=y
```

## src/main.c
```c
#include <errno.h>

#include <zephyr/device.h>
#include <zephyr/dfu/mcuboot.h>
#include <zephyr/drivers/rtc.h>
#include <zephyr/drivers/watchdog.h>
#include <zephyr/kernel.h>
#include <zephyr/logging/log.h>
#include <zephyr/shell/shell.h>
#include <zephyr/task_wdt/task_wdt.h>

#include "board_io.h"
#include "led.h"
#include "params.h"
#include "serial_rx.h"

#define MAIN_WATCHDOG_TIMEOUT_MS 3000
#define MAIN_LOOP_INTERVAL_MS 500

LOG_MODULE_REGISTER(bringup, LOG_LEVEL_INF);

static int cmd_uptime(const struct shell *sh, size_t argc, char **argv)
{
	ARG_UNUSED(argc);
	ARG_UNUSED(argv);

	shell_print(sh, "Uptime: %lld ms", (long long)k_uptime_get());
	return 0;
}

SHELL_CMD_ARG_REGISTER(uptime, NULL, "Show time since boot", cmd_uptime, 1, 0);

int main(void)
{
	const struct device *wdt = DEVICE_DT_GET(DT_NODELABEL(fwdgt));
	int health_channel;
	int err;

	err = app_board_io_init();
	if (err) {
		LOG_ERR("Board I/O initialization failed: %d", err);
		return 0;
	}

	err = app_serial_rx_init();
	if (err) {
		LOG_ERR("Business UART RX initialization failed: %d", err);
		return 0;
	}

	err = app_params_init();
	if (err) {
		LOG_ERR("Parameter initialization failed: %d", err);
		return 0;
	}

	err = app_led_init();
	if (err) {
		LOG_ERR("LED initialization failed: %d", err);
		return 0;
	}

	LOG_INF("Board %s ready; use help, led on/off/blink, uptime", CONFIG_BOARD);
	if (!device_is_ready(DEVICE_DT_GET(DT_ALIAS(rtc0)))) {
		LOG_ERR("RTC HXTAL/128 initialization failed: %d", -ENODEV);
	} else {
		LOG_INF("Hardware RTC: 8 MHz HXTAL/128, prescaler 62499; "
			"set date to enable UTC time");
	}

	if (!device_is_ready(wdt)) {
		LOG_ERR("Hardware watchdog not ready");
		return 0;
	}

	err = task_wdt_init(wdt);
	if (err) {
		LOG_ERR("Watchdog initialization failed: %d", err);
		return 0;
	}

	health_channel = task_wdt_add(MAIN_WATCHDOG_TIMEOUT_MS, NULL, NULL);
	if (health_channel < 0) {
		LOG_ERR("Watchdog registration failed: %d", health_channel);
		return 0;
	}

	LOG_INF("Main task monitored: %d ms; hardware fallback enabled",
		MAIN_WATCHDOG_TIMEOUT_MS);

	/* Confirm only after the current startup checks have succeeded. */
	err = boot_write_img_confirmed();
	if (err) {
		LOG_ERR("Image confirmation failed: %d", err);
		return 0;
	}

	for (;;) {
		err = app_led_update();
		if (err) {
			LOG_ERR("LED toggle failed: %d", err);
			return 0;
		}

		/* Report health only after the monitored work has completed. */
		task_wdt_feed(health_channel);
		k_msleep(MAIN_LOOP_INTERVAL_MS);
	}
}
```

## inc/app.h
```c
#ifndef BRINGUP_APP_H_
/** 防止本头文件在同一编译单元内重复包含。 */
#define BRINGUP_APP_H_

/**
 ******************************************************************************
 * @brief      加载应用参数并启动预充和 RS485 两个线程。
 * @retval     0:线程已启动。
 * @retval     负值:参数加载失败。
 *
 * @details    板级初始化完成后调用一次。成功后将控制权交还调用方。
 ******************************************************************************
 */
int app_run(void);

#endif /* BRINGUP_APP_H_ */
```

## inc/app_clock.h
```c
#ifndef BRINGUP_APP_CLOCK_H_
#define BRINGUP_APP_CLOCK_H_

#include <stdint.h>

/**
 ******************************************************************************
 * @brief      在主板时间与本地 RTC 相差至少五秒时同步。
 * @param[in]  unix_seconds:主板 UTC Unix 秒数，支持 2000～2099 年。
 * @retval     1:已设置 RTC。
 * @retval     0:时差小于五秒，无需设置。
 * @retval     负值:时间无效或 RTC 操作失败。
 ******************************************************************************
 */
int app_clock_sync(uint32_t unix_seconds);

#endif /* BRINGUP_APP_CLOCK_H_ */
```

## inc/host_link.h
```c
#ifndef BRINGUP_HOST_LINK_H_
/** 防止本头文件在同一编译单元内重复包含。 */
#define BRINGUP_HOST_LINK_H_

/**
 ******************************************************************************
 * @brief      启动 RS485 接收与应答线程。
 * @retval     None
 * @details    在串口和应用参数就绪后调用一次。
 ******************************************************************************
 */
void host_link_start(void);

#endif /* BRINGUP_HOST_LINK_H_ */
```

## inc/params.h
```c
#ifndef BRINGUP_PARAMS_H_
/** 防止本头文件在同一编译单元内重复包含。 */
#define BRINGUP_PARAMS_H_

#include <stdint.h>

/**
 ******************************************************************************
 * @brief      初始化 Settings/NVS 并加载设备参数。
 * @retval     0:初始化成功。
 * @retval     负值:存储初始化或参数加载失败。
 *
 * @details    启动时调用一次。缺失的参数采用默认值。
 ******************************************************************************
 */
int app_params_init(void);

/**
 ******************************************************************************
 * @brief      获取 RAM 中的设备编号。
 * @param[out] device_id:编号输出地址，须有效。
 * @retval     0:读取成功。
 * @retval     -EINVAL:输出地址为空。
 * @retval     -EAGAIN:参数模块尚未就绪。
 ******************************************************************************
 */
int app_params_get_device_id(uint32_t *device_id);

/**
 ******************************************************************************
 * @brief      持久化设备编号，成功后更新 RAM 副本。
 * @param[in]  device_id:设备编号，默认值为 1。
 * @retval     0:保存成功。
 * @retval     -EAGAIN:参数模块尚未就绪。
 * @retval     其他负值:存储错误。
 *
 * @details    写入 Flash，须在线程上下文调用。写入期间读取仍返回上次成功值。
 ******************************************************************************
 */
int app_params_set_device_id(uint32_t device_id);

#endif /* BRINGUP_PARAMS_H_ */
```

## inc/precharge.h
```c
#ifndef BRINGUP_PRECHARGE_H_
/** 防止本头文件在同一编译单元内重复包含。 */
#define BRINGUP_PRECHARGE_H_

#include <stdbool.h>
#include <stdint.h>

/** 单次预充同步检测的通道数。 */
#define PRECHARGE_CHANNEL_COUNT 4u

typedef enum
{
    PRECHARGE_CAUSE_NONE,     /**< 无故障。 */
    PRECHARGE_CAUSE_INPUT,    /**< 输入电压检查不通过。 */
    PRECHARGE_CAUSE_VOLTAGE,  /**< 预充结束时电压不合格。 */
    PRECHARGE_CAUSE_ADC,      /**< ADC 采样失败。 */
    PRECHARGE_CAUSE_GPIO,     /**< GPIO 操作失败。 */
    PRECHARGE_CAUSE_HANDOVER, /**< 接管确认超时。 */
    PRECHARGE_CAUSE_RELEASE,  /**< 预充输出释放失败。 */
    PRECHARGE_CAUSE_INTERNAL, /**< 预充线程内部错误。 */
} precharge_cause_e;

/** 对外事件类别。 */
typedef enum
{
    PRECHARGE_EVENT_CANCEL, /**< 本轮接管已失效。 */
    PRECHARGE_EVENT_DONE, /**< 等待主板接管。 */
    PRECHARGE_EVENT_FAULT, /**< 预充或输出故障。 */
    PRECHARGE_EVENT_MP10_FAULT, /**< MP10 故障通道。 */
    PRECHARGE_EVENT_LEAKAGE, /**< 漏电超限。 */
    PRECHARGE_EVENT_COUNT, /**< 事件槽数量。 */
} precharge_event_e;

/** 交付通信任务的事件副本。 */
typedef struct
{
    precharge_event_e type; /**< 事件类别。 */
    uint32_t id; /**< 本地接管标识。 */
    precharge_cause_e cause; /**< 故障原因。 */
    uint8_t channels; /**< 故障通道位图。 */
    int32_t current[PRECHARGE_CHANNEL_COUNT]; /**< 漏电电流，单位 0.1 mA。 */
} precharge_event_t;

/**
 ******************************************************************************
 * @brief      启动预充线程。
 * @retval     0:已创建线程。
 * @details    在板级初始化和参数加载完成后调用一次。
 ******************************************************************************
 */
int precharge_start_task(void);

/**
 ******************************************************************************
 * @brief      提交一次四路预充请求。
 * @retval     0:请求已接收。
 * @retval     -EBUSY:已有活动事务或上次输出释放失败。
 * @retval     -EAGAIN:预充线程尚未就绪。
 ******************************************************************************
 */
int precharge_request_start(void);

/**
 ******************************************************************************
 * @brief      请求停止，允许重复调用，由预充线程撤销输出。
 * @retval     None
 * @details    在线程上下文调用，返回表示请求已提交，撤销失败通过事件交付。
 ******************************************************************************
 */
void precharge_request_stop(void);

/**
 ******************************************************************************
 * @brief      请求预充线程清除故障和待上报故障事件。
 * @retval     None
 * @details    在线程上下文调用。已清除的故障可由检测流程重新确认。
 ******************************************************************************
 */
void precharge_request_clear_faults(void);

/**
 ******************************************************************************
 * @brief      通知预充模块主控旁路已确认吸合。
 * @param[in]  completion_id:完成事件的本地标识。
 * @retval     0:确认已受理，由预充线程释放输出。
 * @retval     -EINVAL:当前未等待接管，或已有停止请求。
 * @retval     -EAGAIN:预充线程尚未就绪。
 * @retval     -ETIMEDOUT:接管确认超过时限。
 ******************************************************************************
 */
int precharge_confirm_handover(uint32_t completion_id);

/**
 ******************************************************************************
 * @brief      领取待发送事件。
 * @param[out] event:事件输出地址。
 * @retval     1:已复制事件。
 * @retval     0:暂无事件。
 * @retval     -EINVAL:输出地址为空。
 ******************************************************************************
 */
int precharge_take_event(precharge_event_t *event);

#endif /* BRINGUP_PRECHARGE_H_ */
```

## src/board_io.c
```c
#include <errno.h>

#include <zephyr/drivers/adc.h>
#include <zephyr/drivers/gpio.h>
#include <zephyr/kernel.h>
#include <zephyr/shell/shell.h>

#include "board_io.h"

#define USER_NODE DT_PATH(zephyr_user)
#define ADC_SPEC(node_id, prop, idx) ADC_DT_SPEC_GET_BY_IDX(node_id, idx),
#define RELAY_SPEC(node_id, prop, idx) GPIO_DT_SPEC_GET_BY_IDX(node_id, prop, idx),

static const struct adc_dt_spec inputs[] = {
	DT_FOREACH_PROP_ELEM(USER_NODE, io_channels, ADC_SPEC)
};
static const char *const input_names[] = DT_PROP(USER_NODE, io_channel_names);
static const struct gpio_dt_spec relays[] = {
	DT_FOREACH_PROP_ELEM(USER_NODE, relay_gpios, RELAY_SPEC)
};
static const struct gpio_dt_spec rs485_de = GPIO_DT_SPEC_GET(USER_NODE, rs485_de_gpios);

static K_MUTEX_DEFINE(board_lock);
static bool board_ready;

BUILD_ASSERT(ARRAY_SIZE(inputs) == ARRAY_SIZE(input_names));
BUILD_ASSERT(ARRAY_SIZE(relays) == 4);

int app_board_io_init(void)
{
	int err;

	/* Establish inactive outputs before allowing any other board operation. */
	for (size_t i = 0; i < ARRAY_SIZE(relays); i++) {
		if (!gpio_is_ready_dt(&relays[i])) {
			return -ENODEV;
		}
		err = gpio_pin_configure_dt(&relays[i], GPIO_OUTPUT_INACTIVE);
		if (err) {
			return err;
		}
	}

	if (!gpio_is_ready_dt(&rs485_de)) {
		return -ENODEV;
	}
	err = gpio_pin_configure_dt(&rs485_de, GPIO_OUTPUT_INACTIVE);
	if (err) {
		return err;
	}

	for (size_t i = 0; i < ARRAY_SIZE(inputs); i++) {
		if (!adc_is_ready_dt(&inputs[i])) {
			return -ENODEV;
		}
		err = adc_channel_setup_dt(&inputs[i]);
		if (err) {
			return err;
		}
	}

	if (!device_is_ready(DEVICE_DT_GET(DT_ALIAS(factory_uart))) ||
	    !device_is_ready(DEVICE_DT_GET(DT_ALIAS(rs485_uart)))) {
		return -ENODEV;
	}

	k_mutex_lock(&board_lock, K_FOREVER);
	board_ready = true;
	k_mutex_unlock(&board_lock);
	return 0;
}

int app_board_relay_set(size_t index, bool enabled)
{
	int err;

	if (index >= ARRAY_SIZE(relays)) {
		return -EINVAL;
	}

	k_mutex_lock(&board_lock, K_FOREVER);
	err = board_ready ? gpio_pin_set_dt(&relays[index], enabled) : -EAGAIN;
	k_mutex_unlock(&board_lock);
	return err;
}

int app_board_rs485_direction_set(bool transmit)
{
	int err;

	k_mutex_lock(&board_lock, K_FOREVER);
	err = board_ready ? gpio_pin_set_dt(&rs485_de, transmit) : -EAGAIN;
	k_mutex_unlock(&board_lock);
	return err;
}

static int cmd_board_adc(const struct shell *sh, size_t argc, char **argv)
{
	struct adc_sequence sequence;
	int16_t raw;
	int32_t millivolts;
	int err;

	ARG_UNUSED(argc);
	ARG_UNUSED(argv);

	k_mutex_lock(&board_lock, K_FOREVER);
	if (!board_ready) {
		k_mutex_unlock(&board_lock);
		return -EAGAIN;
	}
	k_mutex_unlock(&board_lock);

	for (size_t i = 0; i < ARRAY_SIZE(inputs); i++) {
		sequence = (struct adc_sequence){
			.buffer = &raw,
			.buffer_size = sizeof(raw),
		};
		err = adc_sequence_init_dt(&inputs[i], &sequence);
		if (!err) {
			err = adc_read_dt(&inputs[i], &sequence);
		}
		if (err) {
			shell_error(sh, "%s: ADC read failed: %d", input_names[i], err);
			return err;
		}

		/* Pin voltage only: the high-voltage front-end needs separate calibration. */
		millivolts = raw;
		err = adc_raw_to_millivolts_dt(&inputs[i], &millivolts);
		if (err) {
			return err;
		}
		shell_print(sh, "%s: raw=%d, pin=%d mV (nominal VDDA)",
			    input_names[i], raw, millivolts);
	}

	return 0;
}

SHELL_STATIC_SUBCMD_SET_CREATE(board_commands,
	SHELL_CMD_ARG(adc, NULL, "Read eight measurement inputs and the 3 V monitor",
		      cmd_board_adc, 1, 0),
	SHELL_SUBCMD_SET_END
);
SHELL_CMD_REGISTER(board, &board_commands, "Board diagnostics", NULL);
```

## src/board_io.h
```c
#ifndef BRINGUP_BOARD_IO_H_
#define BRINGUP_BOARD_IO_H_

#include <stdbool.h>
#include <stddef.h>

/**
 * @brief Initialize board outputs inactive and configure ADC channels.
 *
 * No relay is energized and RS485 direction defaults to receive. Call once
 * during startup, from thread context, before using the board interfaces.
 *
 * @return 0 on success, or a negative GPIO/ADC/device error code.
 */
int app_board_io_init(void);

/**
 * @brief Control one precharge relay.
 *
 * This low-level function does not implement precharge timing or interlocks.
 * Callers must provide the application sequencing before energizing a relay.
 *
 * @param index Zero-based relay index, 0 through 3.
 * @param enabled True to energize, false to de-energize.
 *
 * @return 0 on success, or a negative GPIO error code.
 * @retval -EINVAL Invalid index.
 * @retval -EAGAIN Board initialization has not completed successfully.
 */
int app_board_relay_set(size_t index, bool enabled);

/**
 * @brief Select the RS485 transceiver direction on PB8.
 *
 * The transceiver direction signal must be physically connected to PB8.
 * Before switching to receive, the caller must wait for the final UART stop
 * bit to leave the transmitter; this function does not serialize UART traffic.
 *
 * @param transmit True for transmit, false for receive.
 *
 * @return 0 on success, or a negative GPIO error code.
 * @retval -EAGAIN Board initialization has not completed successfully.
 */
int app_board_rs485_direction_set(bool transmit);

#endif /* BRINGUP_BOARD_IO_H_ */
```

## src/datetime.c
```c
#include <errno.h>
#include <stdio.h>
#include <time.h>

#include <zephyr/drivers/rtc.h>
#include <zephyr/kernel.h>
#include <zephyr/shell/shell.h>

static const struct device *const rtc_dev = DEVICE_DT_GET(DT_ALIAS(rtc0));
static K_MUTEX_DEFINE(clock_lock);

static int parse_datetime(const char *date, const char *time, struct rtc_time *value)
{
	static const int days[] = {31, 28, 31, 30, 31, 30, 31, 31, 30, 31, 30, 31};
	int year;
	int month;
	int day;
	int hour;
	int minute;
	int second;
	int max_day;
	char extra;

	/* The trailing conversion rejects unexpected characters after each field. */
	if (sscanf(date, "%d-%d-%d%c", &year, &month, &day, &extra) != 3 ||
	    sscanf(time, "%d:%d:%d%c", &hour, &minute, &second, &extra) != 3 ||
	    year < 2000 || year > 2099 || month < 1 || month > 12 ||
	    hour < 0 || hour > 23 || minute < 0 || minute > 59 ||
	    second < 0 || second > 59) {
		return -EINVAL;
	}

	/* All years supported by this driver fall within 2000-2099. */
	max_day = days[month - 1] + (month == 2 && year % 4 == 0);
	if (day < 1 || day > max_day) {
		return -ERANGE;
	}

	value->tm_year = year - 1900;
	value->tm_mon = month - 1;
	value->tm_mday = day;
	value->tm_hour = hour;
	value->tm_min = minute;
	value->tm_sec = second;

	return 0;
}

static int set_datetime(const struct shell *sh, const char *date, const char *time)
{
	struct rtc_time value = {0};
	int err;

	err = parse_datetime(date, time, &value);
	if (err == -ERANGE) {
		shell_error(sh, "Invalid calendar date");
		return -EINVAL;
	}
	if (err) {
		shell_error(sh, "Use: date YYYY-MM-DD HH:MM:SS (UTC, 2000-2099)");
		return err;
	}

	k_mutex_lock(&clock_lock, K_FOREVER);
	err = rtc_set_time(rtc_dev, &value);
	k_mutex_unlock(&clock_lock);
	if (err) {
		shell_error(sh, "RTC write failed: %d", err);
	}

	return err;
}

static int cmd_date(const struct shell *sh, size_t argc, char **argv)
{
	struct rtc_time current = {0};
	int err;

	if (!device_is_ready(rtc_dev)) {
		shell_error(sh, "RTC device not ready");
		return -ENODEV;
	}

	if (argc == 3) {
		err = set_datetime(sh, argv[1], argv[2]);
		if (err) {
			return err;
		}
	} else if (argc != 1) {
		shell_error(sh, "Use: date [YYYY-MM-DD HH:MM:SS]");
		return -EINVAL;
	}

	/* HXTAL does not keep time on VBAT alone; require setting after boot. */
	k_mutex_lock(&clock_lock, K_FOREVER);
	err = rtc_get_time(rtc_dev, &current);
	k_mutex_unlock(&clock_lock);
	if (err) {
		shell_error(sh, "RTC read failed: %d (set date after boot)", err);
		return err;
	}

	shell_print(sh, "%04d-%02d-%02d %02d:%02d:%02d UTC",
		    current.tm_year + 1900, current.tm_mon + 1, current.tm_mday,
		    current.tm_hour, current.tm_min, current.tm_sec);
	return 0;
}

SHELL_CMD_ARG_REGISTER(date, NULL, "UTC RTC time: date [YYYY-MM-DD HH:MM:SS]",
		       cmd_date, 1, 2);
```

## src/led.c
```c
#include <errno.h>
#include <string.h>

#include <zephyr/drivers/gpio.h>
#include <zephyr/kernel.h>
#include <zephyr/shell/shell.h>

#include "led.h"

enum led_mode {
	LED_OFF,
	LED_ON,
	LED_BLINK,
};

static const struct gpio_dt_spec led = GPIO_DT_SPEC_GET(DT_ALIAS(led0), gpios);
static K_MUTEX_DEFINE(led_lock);
static enum led_mode mode = LED_BLINK;
static bool led_ready;

int app_led_init(void)
{
	int err;

	k_mutex_lock(&led_lock, K_FOREVER);
	err = gpio_is_ready_dt(&led) ?
		gpio_pin_configure_dt(&led, GPIO_OUTPUT_INACTIVE) : -ENODEV;
	led_ready = (err == 0);
	k_mutex_unlock(&led_lock);

	return err;
}

int app_led_update(void)
{
	int err;

	k_mutex_lock(&led_lock, K_FOREVER);
	err = mode == LED_BLINK ? gpio_pin_toggle_dt(&led) : 0;
	k_mutex_unlock(&led_lock);

	return err;
}

static int cmd_led(const struct shell *sh, size_t argc, char **argv)
{
	enum led_mode next;
	int err;

	ARG_UNUSED(argc);

	if (!strcmp(argv[1], "on")) {
		next = LED_ON;
	} else if (!strcmp(argv[1], "off")) {
		next = LED_OFF;
	} else if (!strcmp(argv[1], "blink")) {
		next = LED_BLINK;
	} else {
		shell_error(sh, "Usage: led <on|off|blink>");
		return -EINVAL;
	}

	/* Shell commands and the main loop share the GPIO and mode state. */
	k_mutex_lock(&led_lock, K_FOREVER);
	err = led_ready ? gpio_pin_set_dt(&led, next != LED_OFF) : -ENODEV;
	if (!err) {
		mode = next;
	}
	k_mutex_unlock(&led_lock);

	if (err) {
		shell_error(sh, "LED unavailable: %d", err);
		return err;
	}

	shell_print(sh, "LED mode: %s", argv[1]);
	return 0;
}

SHELL_CMD_ARG_REGISTER(led, NULL, "LED control: on, off, blink", cmd_led, 2, 0);
```

## src/led.h
```c
#ifndef BRINGUP_LED_H_
#define BRINGUP_LED_H_

/* Initialize the board LED. Return zero on success or a negative errno. */
int app_led_init(void);

/* Advance blinking once; steady modes remain unchanged. */
int app_led_update(void);

#endif /* BRINGUP_LED_H_ */
```

## src/params.c
```c
#include <errno.h>
#include <stdint.h>
#include <stdlib.h>
#include <string.h>

#include <zephyr/kernel.h>
#include <zephyr/settings/settings.h>
#include <zephyr/shell/shell.h>
#include <zephyr/sys/byteorder.h>

#include "params.h"

#define PARAMS_DEFAULT_DEVICE_ID 1U
#define PARAMS_DEVICE_ID_KEY "app/device_id"

static K_MUTEX_DEFINE(params_lock);
static uint32_t current_device_id = PARAMS_DEFAULT_DEVICE_ID;
static bool params_ready;
static int load_error;

static int params_load(const char *name, size_t len, settings_read_cb read_cb, void *cb_arg)
{
	uint8_t encoded[sizeof(uint32_t)];
	ssize_t count;

	if (strcmp(name, "device_id") != 0) {
		return -ENOENT;
	}
	if (len != sizeof(encoded)) {
		load_error = -EINVAL;
		return load_error;
	}

	count = read_cb(cb_arg, encoded, sizeof(encoded));
	if (count < 0) {
		load_error = (int)count;
		return load_error;
	}
	if (count != sizeof(encoded)) {
		load_error = -EIO;
		return load_error;
	}

	/* Stable on-Flash representation, independent of CPU byte order. */
	k_mutex_lock(&params_lock, K_FOREVER);
	current_device_id = sys_get_le32(encoded);
	k_mutex_unlock(&params_lock);
	return 0;
}

static int params_commit(void)
{
	/* Settings load does not propagate h_set errors; report them at commit. */
	return load_error;
}

SETTINGS_STATIC_HANDLER_DEFINE(app_params, "app", NULL, params_load, params_commit, NULL);

int app_params_init(void)
{
	int err;

	err = settings_subsys_init();
	if (err) {
		return err;
	}

	err = settings_load_subtree("app");
	if (err) {
		return err;
	}

	k_mutex_lock(&params_lock, K_FOREVER);
	params_ready = true;
	k_mutex_unlock(&params_lock);
	return 0;
}

int app_params_get_device_id(uint32_t *device_id)
{
	if (device_id == NULL) {
		return -EINVAL;
	}

	k_mutex_lock(&params_lock, K_FOREVER);
	if (!params_ready) {
		k_mutex_unlock(&params_lock);
		return -EAGAIN;
	}

	*device_id = current_device_id;
	k_mutex_unlock(&params_lock);
	return 0;
}

int app_params_set_device_id(uint32_t device_id)
{
	uint8_t encoded[sizeof(uint32_t)];
	int err;

	k_mutex_lock(&params_lock, K_FOREVER);
	if (!params_ready) {
		k_mutex_unlock(&params_lock);
		return -EAGAIN;
	}

	if (device_id == current_device_id) {
		k_mutex_unlock(&params_lock);
		return 0;
	}

	sys_put_le32(device_id, encoded);
	err = settings_save_one(PARAMS_DEVICE_ID_KEY, encoded, sizeof(encoded));
	if (!err) {
		current_device_id = device_id;
	}
	k_mutex_unlock(&params_lock);
	return err;
}

static int cmd_param_get(const struct shell *sh, size_t argc, char **argv)
{
	uint32_t device_id;
	int err;

	ARG_UNUSED(argc);
	ARG_UNUSED(argv);

	err = app_params_get_device_id(&device_id);
	if (err) {
		shell_error(sh, "Parameter read failed: %d", err);
		return err;
	}

	shell_print(sh, "device_id=%lu", (unsigned long)device_id);
	return 0;
}

static int cmd_param_set(const struct shell *sh, size_t argc, char **argv)
{
	unsigned long parsed;
	char *end;
	int err;

	ARG_UNUSED(argc);

	/* Accept decimal digits only; strtoul alone would accept a minus sign. */
	if (argv[1][0] == '\0' || strspn(argv[1], "0123456789") != strlen(argv[1])) {
		return -EINVAL;
	}

	errno = 0;
	parsed = strtoul(argv[1], &end, 10);
	if (errno == ERANGE || *end != '\0' || parsed > UINT32_MAX) {
		return -ERANGE;
	}

	err = app_params_set_device_id((uint32_t)parsed);
	if (err) {
		shell_error(sh, "Parameter save failed: %d", err);
		return err;
	}

	shell_print(sh, "Saved device_id=%lu", parsed);
	return 0;
}

SHELL_STATIC_SUBCMD_SET_CREATE(param_commands,
	SHELL_CMD_ARG(get, NULL, "Read device identifier", cmd_param_get, 1, 0),
	SHELL_CMD_ARG(set, NULL, "Save decimal device identifier: param set <id>",
		      cmd_param_set, 2, 0),
	SHELL_SUBCMD_SET_END
);
SHELL_CMD_REGISTER(param, &param_commands, "Persistent device parameters", NULL);
```

## src/params.h
```c
#ifndef BRINGUP_PARAMS_H_
#define BRINGUP_PARAMS_H_

#include <stdint.h>

/**
 * @brief Initialize Settings/NVS and load device parameters.
 *
 * Call once during startup before using the other parameter functions.
 * Missing values retain defaults. Initialization never erases the partition
 * as an error-recovery action.
 *
 * @return 0 on success, or a negative error code on storage failure.
 */
int app_params_init(void);

/**
 * @brief Read the device identifier currently held in RAM.
 *
 * @param[out] device_id Destination for the identifier. Must not be NULL.
 *
 * @retval 0 Identifier read successfully.
 * @retval -EINVAL NULL destination.
 * @retval -EAGAIN Parameter initialization has not completed successfully.
 */
int app_params_get_device_id(uint32_t *device_id);

/**
 * @brief Persist a device identifier and update its RAM copy on success.
 *
 * This operation writes Flash and must be called from thread context.
 *
 * @param device_id Identifier in the full uint32_t range; default is 1.
 *
 * @return 0 on success, or a negative storage error code.
 * @retval -EAGAIN Parameter initialization has not completed successfully.
 */
int app_params_set_device_id(uint32_t device_id);

#endif /* BRINGUP_PARAMS_H_ */
```
